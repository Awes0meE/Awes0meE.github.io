#include "app.h"
#include "dwt_delay.h"
#include "encoder.h"
#include "dht.h"
#include "oled.h"
#include "bluetooth.h"
#include "fan.h"
#include "ir.h"
#include "button.h"
#include "nvstore.h"

volatile uint8_t isLaptopAbove = 0;

static TIM_HandleTypeDef  *s_htim2;
static TIM_HandleTypeDef  *s_htim3;
static I2C_HandleTypeDef  *s_hi2c1;
static UART_HandleTypeDef *s_huart1;

static ENC_Handle enc;
static DHT_Handle dht_env;
static DHT_Handle dht_out;
static FAN_Handle fan1;
static IR_Handle  ir;
static BTN_Handle pwr_btn;

static float envT = 0.0f, envH = 0.0f;
static float outT = 0.0f, outH = 0.0f;

static uint8_t fan_set = 0;        // 风扇设定值，默认 0
static uint8_t fan_logic_out = 0;
static uint8_t fan_pwm_out = 0;

static uint32_t t_dht  = 0;
static uint32_t t_oled = 0;
static uint32_t t_bt   = 0;

#define IR_PORT          GPIOB
#define IR_PIN           GPIO_PIN_0
#define IR_ACTIVE_LEVEL  GPIO_PIN_RESET

#define PWR_BTN_PORT     GPIOB
#define PWR_BTN_PIN      GPIO_PIN_1
#define PWR_BTN_ACTIVE   GPIO_PIN_RESET

#define BOOT_LOGO_HOLD_MS   3000U   // 开机 Logo 显示时长：3 秒
#define APP_DHT_PERIOD_MS   2000U
#define APP_BT_PERIOD_MS    3000U
#define APP_OLED_PERIOD_MS  200U
#define APP_CONFIRM_MS      5000U
#define APP_FAN_SAVE_DELAY_MS 4000U

typedef enum {
    UI_NORMAL = 0,
    UI_CONFIRM,
    UI_OFF,
    UI_BOOT
} UiState;

static UiState ui_state = UI_OFF;   // 上电默认 OFF
static uint32_t confirm_deadline = 0;
static uint8_t last_sec_left = 0xFF;
static uint32_t boot_deadline = 0;
static uint8_t fan_saved = 0;
static uint8_t fan_dirty = 0;
static uint32_t fan_save_deadline = 0;

// 关机后必须先松开按键，再允许下一次按下触发唤醒
static uint8_t wake_armed = 0;

/*
 * 开机 Logo 位图数据（128x64，1bpp，1024 字节）
 */
static const uint8_t g_boot_logo[1168] = {
		0x00, 0x00, 0x00, 0x00, 0x00, 0x00, 0x00, 0x00, 0x00, 0x00, 0x00, 0x00, 0x00, 0x00, 0x00, 0x00, 0x00, 0x00, 0x00, 0x00, 0x00, 0x00, 0x00, 0x00,
		0x00, 0x00, 0x00, 0x00, 0x00, 0x00, 0x00, 0x00, 0x00, 0x00, 0x00, 0x00, 0x00, 0x00, 0x00, 0x00, 0x00, 0x00, 0x80, 0xc0, 0xe0, 0xf0, 0xf0, 0x78,
		0x38, 0x3c, 0x1c, 0x1e, 0x0e, 0x0e, 0x07, 0x07, 0x07, 0x03, 0x03, 0x03, 0x03, 0x03, 0x03, 0x03, 0x03, 0x03, 0x03, 0x03, 0x03, 0x03, 0x07, 0x07,
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		0xc0, 0xc0, 0xe0, 0xe0, 0xe0, 0x70, 0x70, 0x60, 0x20, 0x3c, 0x20, 0x06, 0x06, 0x07, 0x03, 0x03, 0x00, 0x00, 0x00, 0x00, 0x00, 0x00, 0x00, 0x00,

		};

static uint8_t calc_sec_left(uint32_t now, uint32_t deadline)
{
    if ((int32_t)(deadline - now) <= 0) return 0;
    return (uint8_t)(((deadline - now) + 999U) / 1000U);
}

static inline void app_idle_once(void)
{
    // Sleep until next interrupt (usually SysTick), reducing busy-wait power.
    __WFI();
}

static void app_mark_fan_dirty(uint32_t now)
{
    if (fan_set != fan_saved) {
        fan_dirty = 1;
        fan_save_deadline = now + APP_FAN_SAVE_DELAY_MS;
    }
}

static void app_try_persist_fan(uint32_t now, uint8_t force)
{
    if (!fan_dirty) return;
    if (!force && ((int32_t)(now - fan_save_deadline) < 0)) return;

    if (NVM_SaveFanSet(fan_set)) {
        fan_saved = fan_set;
        fan_dirty = 0;
    } else {
        fan_save_deadline = now + APP_FAN_SAVE_DELAY_MS;
    }
}

static void app_update_main_logic(uint32_t now)
{
    // IR presence
    isLaptopAbove = IR_UpdateAndGet(&ir);

    // Encoder to fan setpoint
    uint8_t old_fan_set = fan_set;
    int16_t delta = ENC_GetDelta(&enc);
    if (delta != 0) {
        fan_set = ENC_ApplyDeltaToSpeed(&enc, fan_set, delta);
        if (fan_set != old_fan_set) {
            app_mark_fan_dirty(now);
        }
    }

    // Sensor sampling
    if ((int32_t)(now - t_dht) >= 0) {
        t_dht = now + APP_DHT_PERIOD_MS;

        float t, h;

        if (DHT_Read(&dht_env, &t, &h)) {
            envT = t;
            envH = h;
        }

        if (DHT_Read(&dht_out, &t, &h)) {
            outT = t;
            outH = h;
        }
    }

    // Logical output, active only in NORMAL / CONFIRM
    fan_logic_out = isLaptopAbove ? fan_set : 0;

    // Physical PWM output
    // Force 0 in OFF / BOOT
    if (ui_state == UI_OFF || ui_state == UI_BOOT) {
        if (fan_pwm_out != 0) {
            fan_pwm_out = 0;
            FAN_SetDuty(&fan1, 0);
        }
    } else {
        if (fan_pwm_out != fan_logic_out) {
            fan_pwm_out = fan_logic_out;
            FAN_SetDuty(&fan1, fan_pwm_out);
        }
    }

    // Bluetooth report: skip when OFF
    if (ui_state != UI_OFF) {
        if ((int32_t)(now - t_bt) >= 0) {
            t_bt = now + APP_BT_PERIOD_MS;
            BT_Report(envT, envH, outT, outH, fan_pwm_out);
        }
    }
}

static void enter_confirm(uint32_t now)
{
    ui_state = UI_CONFIRM;
    confirm_deadline = now + APP_CONFIRM_MS;
    last_sec_left = 0xFF;

    OLED_InvalidateCache();
    (void)OLED_RenderShutdownConfirm(5);
}

static void cancel_confirm_and_back_to_normal(uint32_t now)
{
    ui_state = UI_NORMAL;
    confirm_deadline = 0;
    last_sec_left = 0xFF;

    OLED_InvalidateCache();
    (void)OLED_Clear();
    (void)OLED_Render(envT, envH, outT, outH, fan_pwm_out);

    t_oled = now + APP_OLED_PERIOD_MS;
}

static void enter_off(uint32_t now)
{
    app_try_persist_fan(now, 1);

    ui_state = UI_OFF;
    confirm_deadline = 0;
    last_sec_left = 0xFF;

    fan_pwm_out = 0;
    FAN_SetDuty(&fan1, 0);

    (void)OLED_DisplayOff();

    wake_armed = 0;
}

static void wake_to_boot(uint32_t now)
{
    ui_state = UI_BOOT;
    confirm_deadline = 0;
    last_sec_left = 0xFF;
    boot_deadline = now + BOOT_LOGO_HOLD_MS;

    (void)OLED_DisplayOn();
    HAL_Delay(2);

    // BOOT 状态下风扇强制不转，但传感器照常开始采样
    fan_pwm_out = 0;
    FAN_SetDuty(&fan1, 0);

    t_dht = now;   // Logo 期间也执行采样

    (void)OLED_ShowBitmapFull(g_boot_logo);
    OLED_InvalidateCache();

    wake_armed = 1;
}

static void boot_to_normal(uint32_t now)
{
    ui_state = UI_NORMAL;
    boot_deadline = 0;

    // Logo 结束后恢复风扇输出
    isLaptopAbove = IR_UpdateAndGet(&ir);
    fan_logic_out = isLaptopAbove ? fan_set : 0;
    fan_pwm_out = fan_logic_out;
    FAN_SetDuty(&fan1, fan_pwm_out);

    OLED_InvalidateCache();
    (void)OLED_Clear();
    (void)OLED_Render(envT, envH, outT, outH, fan_pwm_out);

    t_oled = now + APP_OLED_PERIOD_MS;
}

void APP_BindHandles(TIM_HandleTypeDef *htim2, TIM_HandleTypeDef *htim3,
                     I2C_HandleTypeDef *hi2c1, UART_HandleTypeDef *huart1)
{
    s_htim2  = htim2;
    s_htim3  = htim3;
    s_hi2c1  = hi2c1;
    s_huart1 = huart1;
}

void APP_Init(void)
{
    DWT_Delay_Init();

    FAN_Init(&fan1, s_htim2, TIM_CHANNEL_3);
    ENC_Init(&enc, s_htim3, 2, 1);
    BT_Init(s_huart1);

    DHT_Init(&dht_env, GPIOA, GPIO_PIN_0, DHT_TYPE_11);
    DHT_Init(&dht_out, GPIOA, GPIO_PIN_1, DHT_TYPE_22);

    IR_Init(&ir, IR_PORT, IR_PIN, IR_ACTIVE_LEVEL, 50);
    BTN_Init(&pwr_btn, PWR_BTN_PORT, PWR_BTN_PIN, PWR_BTN_ACTIVE, 50);

    (void)OLED_Begin(s_hi2c1);
    OLED_InvalidateCache();

    (void)NVM_Init();

    uint32_t now = HAL_GetTick();

    t_dht  = now + APP_DHT_PERIOD_MS;
    t_oled = now;
    t_bt   = now;

    // 上电默认黑屏 + 风扇停转 + 等待首次按键启动
    ui_state = UI_OFF;
    confirm_deadline = 0;
    last_sec_left = 0xFF;
    boot_deadline = 0;

    uint8_t loaded_fan = 0;
    if (NVM_LoadFanSet(&loaded_fan) && loaded_fan <= 100U) {
        fan_set = loaded_fan;
    } else {
        fan_set = 0;
    }
    fan_saved = fan_set;
    fan_dirty = 0;
    fan_save_deadline = 0;

    fan_logic_out = 0;
    fan_pwm_out = 0;
    FAN_SetDuty(&fan1, 0);

    (void)OLED_Clear();
    (void)OLED_DisplayOff();

    // 如果上电时按键未按下，则允许首次按下直接唤醒
    wake_armed = (pwr_btn.stable_pressed == 0) ? 1 : 0;
}

void APP_Loop(void)
{
    uint32_t now = HAL_GetTick();
    uint8_t btn_press = BTN_UpdatePressEvent(&pwr_btn);

    app_try_persist_fan(now, 0);

    // OFF: wait for release, then allow next press to wake up.
    if (ui_state == UI_OFF) {
        if (!wake_armed) {
            if (pwr_btn.stable_pressed == 0) {
                wake_armed = 1;
            }
            app_idle_once();
            return;
        }

        if (btn_press) {
            wake_to_boot(now);
        }
        app_idle_once();
        return;
    }

    // NORMAL / CONFIRM / BOOT：主逻辑继续运行
    app_update_main_logic(now);

    // BOOT: show logo and keep fan stopped.
    if (ui_state == UI_BOOT) {
        if ((int32_t)(now - boot_deadline) >= 0) {
            boot_to_normal(now);
        }
        app_idle_once();
        return;
    }

    if (ui_state == UI_NORMAL) {
        if (btn_press) {
            enter_confirm(now);
            app_idle_once();
            return;
        }

        if ((int32_t)(now - t_oled) >= 0) {
            t_oled = now + APP_OLED_PERIOD_MS;
            (void)OLED_Render(envT, envH, outT, outH, fan_pwm_out);
        }

        app_idle_once();
        return;
    }

    if (ui_state == UI_CONFIRM) {
        if (btn_press) {
            enter_off(now);
            app_idle_once();
            return;
        }

        if ((int32_t)(now - confirm_deadline) >= 0) {
            cancel_confirm_and_back_to_normal(now);
            app_idle_once();
            return;
        }

        uint8_t sec_left = calc_sec_left(now, confirm_deadline);
        if (sec_left != last_sec_left) {
            last_sec_left = sec_left;
            (void)OLED_RenderShutdownConfirm(sec_left);
        }

        app_idle_once();
        return;
    }

    app_idle_once();
}


